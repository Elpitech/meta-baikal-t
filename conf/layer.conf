## conf/layer.conf
```bitbake
# We have a conf and classes directory, add to BBPATH
BBPATH .= ":${LAYERDIR}"

# We have recipes-* directories, add to BBFILES
BBFILES += "${LAYERDIR}/recipes-*/*/*.bb \
            ${LAYERDIR}/recipes-*/*/*.bbappend"

BBFILE_COLLECTIONS += "meta-baikal-t"
BBFILE_PATTERN_meta-baikal-t = "^${LAYERDIR}/"
BBFILE_PRIORITY_meta-baikal-t = "6"

LAYERDEPENDS_meta-baikal-t = "core"

LAYERSERIES_COMPAT_meta-baikal-t = "honister"
```

## conf/machine/axt1-msbt2.conf
```bitbake
#@TYPE: Machine
#@NAME: Axitech v1 MSBT2 MIPS
#@DESCRIPTION: Baikal-T1 based T-platforms Axitech v1 MSBT2 board

require conf/machine/include/baikal-t.inc

# Kernel and bootloader default configs
KBUILD_DEFCONFIG = "tplatforms_axt1-msbt2_defconfig"
KERNEL_DEVICETREE = "baikal/tplatforms_axt1-msbt2.dtb"
UBOOT_MACHINE = "tplatforms_axt1-msbt2_defconfig"
```

## conf/machine/axt1-sfbt1.conf
```bitbake
#@TYPE: Machine
#@NAME: Axitech v1 SFBT1 MIPS
#@DESCRIPTION: Baikal-T based T-platforms Axitech v1 SFBT1 board

require conf/machine/include/baikal-t.inc

# Kernel and bootloader default configs
KBUILD_DEFCONFIG = "tplatforms_axt1-sfbt1_defconfig"
KERNEL_DEVICETREE = "baikal/tplatforms_axt1-sfbt1.dtb"
UBOOT_MACHINE = "tplatforms_axt1-sfbt1_defconfig"
```

## conf/machine/azure.conf
```bitbake
#@TYPE: Machine
#@NAME: Azure MIPS
#@DESCRIPTION: Baikal-T1 based T-platforms Azure switch

require conf/machine/include/baikal-t.inc

# Kernel and bootloader default configs
KBUILD_DEFCONFIG = "tplatforms_azure_defconfig"
KERNEL_DEVICETREE = "baikal/tplatforms_rt1mb.dtb"
UBOOT_MACHINE = "tplatforms_azure_defconfig"

PREFERRED_VERSION_linux-yocto = "4.9%"
KBRANCH ?= "linux-4.9-tp"

PREFERRED_VERSION_u-boot = "2019"
PREFERRED_VERSION_u-boot-mkimage = "2019"
PREFERRED_VERSION_u-boot-mkimage-native = "2019"
PREFERRED_VERSION_u-boot-mkimage-nativesdk = "2019"
PREFERRED_VERSION_u-boot-fw-utils = "2019"
```

## conf/machine/bc3bt1-mrbt1.conf
```bitbake
#@TYPE: Machine
#@NAME: Axitech BC3BT1 MRBT1 MIPS
#@DESCRIPTION: Baikal-T1 based T-platforms Axitech BC3BT1 MRBT1 board

require conf/machine/include/baikal-t.inc

# Kernel and bootloader default configs
KBUILD_DEFCONFIG = "tplatforms_bc3bt1-mrbt1_defconfig"
KERNEL_DEVICETREE = "baikal/tplatforms_bc3bt1-mrbt1.dtb"
UBOOT_MACHINE = "tplatforms_bc3bt1-mrbt1_defconfig"
```

## conf/machine/bfk.conf
```bitbake
#@TYPE: Machine
#@NAME: BFK MIPS
#@DESCRIPTION: Baikal-T based Baikal BFK v1.0, v1.5, v1.6 evaluation boards

require conf/machine/include/baikal-t.inc

# Kernel and bootloader default configs
KBUILD_DEFCONFIG = "baikal_bfk_defconfig"
KERNEL_DEVICETREE = "baikal/baikal_bfk.dtb"
UBOOT_MACHINE = "baikal_bfk_defconfig"
```

## conf/machine/bfk3.conf
```bitbake
#@TYPE: Machine
#@NAME: BFK3 MIPS
#@DESCRIPTION: Baikal-T1 based Baikal BFK v2.0, v3.x evaluation boards

require conf/machine/include/baikal-t.inc

# Kernel and bootloader default configs
KBUILD_DEFCONFIG = "baikal_bfk3_defconfig"
KERNEL_DEVICETREE = "baikal/baikal_bfk3.dtb \
                     baikal/baikal_bfk2.dtb"
UBOOT_MACHINE = "baikal_bfk3_defconfig"
```

## conf/machine/bfkx.conf
```bitbake
#@TYPE: Machine
#@NAME: BFKx MIPS
#@DESCRIPTION: Baikal-T1 based Baikal BFK v1.6 evaluation boards

require conf/machine/include/baikal-t.inc

# Kernel and bootloader default configs
KBUILD_DEFCONFIG = "baikal_bfkx_defconfig"
KERNEL_DEVICETREE = "baikal/baikal_bfkx.dtb"
UBOOT_MACHINE = "baikal_bfkx_defconfig"
```

## conf/machine/bn1bt1.conf
```bitbake
#@TYPE: Machine
#@NAME: BN1BT1 MIPS
#@DESCRIPTION: Baikal-T1 based T-platforms BN1BT1 board

require conf/machine/include/baikal-t.inc

# Kernel and bootloader default configs
KBUILD_DEFCONFIG = "tplatforms_bn1bt1_defconfig"
KERNEL_DEVICETREE = "baikal/tplatforms_bn1bt1.dtb"
UBOOT_MACHINE = "tplatforms_bn1bt1_defconfig"

PREFERRED_VERSION_linux-yocto = "4.9%"

KBRANCH ?= "linux-4.9-tp-oland-se"
```

## conf/machine/cnc-msbt2.conf
```bitbake
#@TYPE: Machine
#@NAME: CNC MSBT2 MIPS
#@DESCRIPTION: Baikal-T1 based T-platforms CNC MSBT2 boards

require conf/machine/include/baikal-t.inc

PREFERRED_VERSION_linux-yocto = "4.9%"

# Kernel and bootloader default configs
KBUILD_DEFCONFIG = "tplatforms_cnc-msbt2_defconfig"
KERNEL_DEVICETREE = "baikal/tplatforms_msbt2.dtb \
                     baikal/tplatforms_cnccu-msbt2.dtb baikal/tplatforms_cnccu3-msbt2.dtb \
                     baikal/tplatforms_cncin-msbt2.dtb baikal/tplatforms_cncin3-msbt2.dtb \
                     baikal/tplatforms_cncout-msbt2.dtb baikal/tplatforms_cncout3-msbt2.dtb \
                     baikal/tplatforms_cncttl-msbt2.dtb baikal/tplatforms_cncttl3-msbt2.dtb \
                     baikal/tplatforms_cncdac-msbt2.dtb  baikal/tplatforms_cncdac3-msbt2.dtb"
UBOOT_MACHINE = "tplatforms_cnc-msbt2_defconfig"
```

## conf/machine/cnc-sfbt1.conf
```bitbake
#@TYPE: Machine
#@NAME: CNC SFBT1 MIPS
#@DESCRIPTION: Baikal-T based T-platforms CNC SFBT1 boards

require conf/machine/include/baikal-t.inc

# Kernel and bootloader default configs
KBUILD_DEFCONFIG = "tplatforms_cnc-sfbt1_defconfig"
KERNEL_DEVICETREE = "baikal/tplatforms_sfbt1.dtb \
                     baikal/tplatforms_cnccu-sfbt1.dtb baikal/tplatforms_cnccu3-sfbt1.dtb \
                     baikal/tplatforms_cncin-sfbt1.dtb baikal/tplatforms_cncin3-sfbt1.dtb \
                     baikal/tplatforms_cncout-sfbt1.dtb baikal/tplatforms_cncout3-sfbt1.dtb \
                     baikal/tplatforms_cncttl-sfbt1.dtb baikal/tplatforms_cncttl3-sfbt1.dtb \
                     baikal/tplatforms_cncdac-sfbt1.dtb  baikal/tplatforms_cncdac3-sfbt1.dtb"
UBOOT_MACHINE = "tplatforms_cnc-sfbt1_defconfig"
```

## conf/machine/em406-b.conf
```bitbake
#@TYPE: Machine
#@NAME: MSBT2 MIPS
#@DESCRIPTION: Baikal-T1 based T-platforms EM406-B module

require conf/machine/include/baikal-t.inc

# Kernel and bootloader default configs
KBUILD_DEFCONFIG = "tplatforms_msbt2_defconfig"
KERNEL_DEVICETREE = "baikal/tplatforms_msbt2.dtb \
                     baikal/tplatforms_xa1-msbt2.dtb"
UBOOT_MACHINE = "tplatforms_em406-b_defconfig"
```

## conf/machine/et402.conf
```bitbake
#@TYPE: Machine
#@NAME: ET402 MIPS
#@DESCRIPTION: Baikal-T1 based T-platforms ET402 module

require conf/machine/include/baikal-t.inc

# Kernel and bootloader default configs
KBUILD_DEFCONFIG = "elpitech_et402_defconfig"
KERNEL_DEVICETREE = "baikal/elpitech_et402.dtb"
UBOOT_MACHINE = "elpitech_et402_defconfig"

PREFERRED_VERSION_linux-yocto = "4.9%"
KBRANCH ?= "linux-4.9-elp"
```

## conf/machine/et412.conf
```bitbake
#@TYPE: Machine
#@NAME: ET412 MIPS
#@DESCRIPTION: Baikal-T1 based Elpitech et412 board

require conf/machine/include/baikal-t.inc

# Kernel and bootloader default configs
KBUILD_DEFCONFIG = "elpitech_et412_defconfig"
KERNEL_DEVICETREE = "baikal/elpitech_et412.dtb"
UBOOT_MACHINE ?= "elpitech_et412_defconfig"

PREFERRED_VERSION_linux-yocto = "4.9%"
KBRANCH ?= "linux-4.9-tp-spi-display"
```

## conf/machine/include/baikal-t.inc
```bitbake
DEFAULTTUNE = "p5600el"

# Baikal-T(1) is based on MIPS Warrior P-class P5600 core
require conf/machine/include/tune-p5600.inc

SOC_FAMILY = "baikal"
require conf/machine/include/soc-family.inc

# Each Baikal-T is equipped with serial, pci and usb controllers
MACHINE_FEATURES = "serial pci usbhost"
SERIAL_CONSOLE = "115200 ttyS0"

# External sources settings
INHERIT += "externalsrc"
EXTERNAL_KERNEL_SRC ?= ""
EXTERNAL_UBOOT_SRC ?= ""

# Default kernel code parameters
LINUXLIBCVERSION ?= "4.4%"
PREFERRED_VERSION_linux-baikal ?= "4.4%"
PREFERRED_PROVIDER_virtual/kernel ?= "linux-baikal"

# Default u-boot code parameters
PREFERRED_VERSION_u-boot-baikal ?= "2014.10"
PREFERRED_PROVIDER_virtual/bootloader ?= "u-boot-baikal"
PREFERRED_PROVIDER_u-boot ?= "u-boot-baikal"
PREFERRED_PROVIDER_u-boot-mkimage ?= "u-boot-baikal-mk-tools"
PREFERRED_PROVIDER_u-boot-mkimage-native ?= "u-boot-baikal-mk-tools-native"
PREFERRED_PROVIDER_u-boot-mkimage-nativesdk ?= "u-boot-baikal-mk-tools-nativesdk"
PREFERRED_PROVIDER_u-boot-fw-utils ?= "u-boot-baikal-fw-utils"
UBOOT_LOADADDRESS ??= "${UBOOT_VMLINUX_LOADADDRESS}"
UBOOT_ENTRYSYMBOL ??= "kernel_entry"
UBOOT_VMLINUZ_LOADADDRESS ??= "0x86100000"
UBOOT_VMLINUX_LOADADDRESS ??= "0x80100000"
UBOOT_FDT_LOADADDRESS ??= "0x86000000"
UBOOT_RD_LOADADDRESS ??= "0x87000000"

# Set default kernel/bootloader output binary names and symlinks
KERNEL_IMAGE_BASE_NAME ?= "${PKGV}-${PKGR}-${MACHINE}-${DATETIME}"
KERNEL_IMAGE_SYMLINK_NAME ?= "${MACHINE}"
MODULE_TARBALL_BASE_NAME ?= "modules-${PKGV}-${PKGR}-${MACHINE}-${DATETIME}.tgz"
MODULE_TARBALL_SYMLINK_NAME ?= "modules-${MACHINE}.tgz"
DTB_IMAGE_BASE_NAME ?= "${PKGV}-${PKGR}-${MACHINE}-${DATETIME}"
DTB_IMAGE_SYMLINK_NAME ?= "${MACHINE}"
FIT_IMAGE_BASE_NAME ?= "${PKGV}-${PKGR}-${MACHINE}-${DATETIME}"
FIT_IMAGE_SYMLINK_NAME ?= "${MACHINE}"
UBOOT_BASE_NAME ?= "${PKGV}-${PKGR}-${MACHINE}-${DATETIME}"
UBOOT_SYMLINK_NAME ?= "${MACHINE}"
UBOOT_DTB_BINARY ?= "u-boot-${UBOOT_SYMLINK_NAME}.dtb"
UBOOT_ENV_BASE_NAME ?= "u-boot-env-${PKGV}-${PKGR}-${MACHINE}-${DATETIME}"
UBOOT_ENV_SYMLINK_NAME ?= "u-boot-env-${MACHINE}"
```

## conf/machine/include/tune-mips32r5.inc
```bitbake
DEFAULTTUNE ?= "mips32r5"

require conf/machine/include/tune-mips32.inc

# Add the CCFLAGS to have software properly optimized for MIPS32r5 arch
TUNEVALID[mips32r5] = "Enable mips32r5 specific processor optimizations"
TUNECONFLICTS[mips32r5] = "n64 n32"
TUNE_CCARGS .= "${@bb.utils.contains('TUNE_FEATURES', 'mips32r5', ' -march=mips32r5', '', d)}"

# Base Tunes (Hard Float)
AVAILTUNES += "mips32r5 mips32r5el"

TUNE_FEATURES_tune-mips32r5 = "${TUNE_FEATURES_tune-mips} mips32r5"
MIPSPKGSFX_VARIANT_tune-mips32r5 = "mips32r5"
PACKAGE_EXTRA_ARCHS_tune-mips32r5 = "mips mips32 mips32r5"

TUNE_FEATURES_tune-mips32r5el = "${TUNE_FEATURES_tune-mipsel} mips32r5"
MIPSPKGSFX_VARIANT_tune-mips32r5el = "mips32r5el"
PACKAGE_EXTRA_ARCHS_tune-mips32r5el = "mipsel mips32el mips32r5el"

# Soft Float
AVAILTUNES += "mips32r5-nf mips32r5el-nf"

TUNE_FEATURES_tune-mips32r5-nf = "${TUNE_FEATURES_tune-mips-nf} mips32r5"
MIPSPKGSFX_VARIANT_tune-mips32r5-nf = "mips32r5"
PACKAGE_EXTRA_ARCHS_tune-mips32r5-nf = "mips-nf mips32-nf mips32r5-nf"

TUNE_FEATURES_tune-mips32r5el-nf = "${TUNE_FEATURES_tune-mipsel-nf} mips32r5"
MIPSPKGSFX_VARIANT_tune-mips32r5el-nf = "mips32r5el"
PACKAGE_EXTRA_ARCHS_tune-mips32r5el-nf = "mipsel-nf mips32el-nf mips32r5el-nf"

# Set GCC default build settings
MIPS32R5_OECONF    += "--with-abi=32 --with-arch=mips32r5 --with-float=hard"
MIPS32R5_NF_OECONF += "--with-abi=32 --with-arch=mips32r5 --with-float=soft"
EXTRA_OECONF_append_pn-gcc  = " ${@'${MIPS32R5_OECONF}' if '${DEFAULTTUNE}' in ['mips32r5', 'mips32r5el'] else ''}"
EXTRA_OECONF_append_pn-gcc += " ${@'${MIPS32R5_NF_OECONF}' if '${DEFAULTTUNE}' in ['mips32r5-nf', 'mips32r5el-nf'] else ''}"
EXTRA_OECONF_append_pn-gcc-cross-initial-${TARGET_ARCH}  = " ${@'${MIPS32R5_OECONF}' if '${DEFAULTTUNE}' in ['mips32r5', 'mips32r5el'] else ''}"
EXTRA_OECONF_append_pn-gcc-cross-initial-${TARGET_ARCH} += " ${@'${MIPS32R5_NF_OECONF}' if '${DEFAULTTUNE}' in ['mips32r5-nf', 'mips32r5el-nf'] else ''}"
EXTRA_OECONF_append_pn-gcc-cross-${TARGET_ARCH}  = " ${@'${MIPS32R5_OECONF}' if '${DEFAULTTUNE}' in ['mips32r5', 'mips32r5el'] else ''}"
EXTRA_OECONF_append_pn-gcc-cross-${TARGET_ARCH} += " ${@'${MIPS32R5_NF_OECONF}' if '${DEFAULTTUNE}' in ['mips32r5-nf', 'mips32r5el-nf'] else ''}"
EXTRA_OECONF_append_pn-gcc-cross-canadian-${TARGET_ARCH}  = " ${@'${MIPS32R5_OECONF}' if '${DEFAULTTUNE}' in ['mips32r5', 'mips32r5el'] else ''}"
EXTRA_OECONF_append_pn-gcc-cross-canadian-${TARGET_ARCH} += " ${@'${MIPS32R5_NF_OECONF}' if '${DEFAULTTUNE}' in ['mips32r5-nf', 'mips32r5el-nf'] else ''}"
```

## conf/machine/include/tune-p5600.inc
```bitbake
DEFAULTTUNE ?= "p5600"

require conf/machine/include/tune-mips32r5.inc

# MIPS Warrior P5600 tuning feature
TUNEVALID[p5600] = "MIPS Warrior P-class P5600 Multiprocessor core"
TUNECONFLICTS[p5600] = "n64 n32"
TUNE_CCARGS .= "${@bb.utils.contains('TUNE_FEATURES', 'p5600', ' -march=mips32r5 -mtune=p5600', '', d)}"

# Base Tunes (Hard Float)
AVAILTUNES += "p5600 p5600el"

TUNE_FEATURES_tune-p5600 = "${TUNE_FEATURES_tune-mips} p5600"
MIPSPKGSFX_VARIANT_tune-p5600 = "p5600"
PACKAGE_EXTRA_ARCHS_tune-p5600 = "mips mips32 mips32r2 mips32r5 p5600"

TUNE_FEATURES_tune-p5600el = "${TUNE_FEATURES_tune-mipsel} p5600"
MIPSPKGSFX_VARIANT_tune-p5600el = "p5600el"
PACKAGE_EXTRA_ARCHS_tune-p5600el = "mipsel mips32el mips32r2el mips32r5el p5600el"

# Soft Float
AVAILTUNES += "p5600-nf p5600el-nf"

TUNE_FEATURES_tune-p5600-nf = "${TUNE_FEATURES_tune-mips-nf} p5600"
MIPSPKGSFX_VARIANT_tune-p5600-nf = "p5600"
PACKAGE_EXTRA_ARCHS_tune-p5600-nf = "mips-nf mips32-nf mips32r2-nf mips32r5-nf p5600-nf"

TUNE_FEATURES_tune-p5600el-nf = "${TUNE_FEATURES_tune-mipsel-nf} p5600"
MIPSPKGSFX_VARIANT_tune-p5600el-nf = "p5600el"
PACKAGE_EXTRA_ARCHS_tune-p5600el-nf = "mipsel-nf mips32el-nf mips32r2el-nf mips32r5el-nf p5600el-nf"

# MIPS 64-bits floating point registers feature
TUNEVALID[fp64] = "Use MIPS 64-bits FP registers"
TUNE_CCARGS .= "${@bb.utils.contains('TUNE_FEATURES', 'fp64', ' -mfp64', '', d)}"

# MIPS eXtended Physical Address (XPA) instructions
TUNEVALID[xpa] = "Use MIPS XPA instructions"
TUNE_CCARGS .= "${@bb.utils.contains('TUNE_FEATURES', 'xpa', ' -mxpa', '', d)}"

# MIPS Enhanced Virtual Addressing instructions
TUNEVALID[eva] = "Use MIPS EVA instructions"
TUNE_CCARGS .= "${@bb.utils.contains('TUNE_FEATURES', 'eva', ' -meva', '', d)}"

# MIPS Virtualization (VZ) instructions
TUNEVALID[virt] = "Use MIPS VZ instructions"
TUNE_CCARGS .= "${@bb.utils.contains('TUNE_FEATURES', 'virt', ' -mvirt', '', d)}"

# MIPS SIMD registers and instructions
TUNEVALID[msa] = "Use MIPS SIMD instructions"
TUNE_P5600_MSA = ""
TUNE_CCARGS .= "${@bb.utils.contains('TUNE_FEATURES', 'msa', ' ${TUNE_P5600_MSA}', '', d)}"
# MSA is supported by GCC 7.1 and newer, so lets discard the feature if it is unsupported by compiler
# NOTE we can't use inline python here since external_run hasn't defined before TUNE_FEATURE is referenced
python p5600_gcc_check_msa () {
    gcc_major = int((d.getVar('GCCVERSION', True) or '0').replace('%', '').split('.')[0])
    if gcc_major >= 7:
        d.setVar('TUNE_P5600_MSA', '-mmsa')
}
p5600_gcc_check_msa[eventmask] = "bb.event.ConfigParsed"
addhandler p5600_gcc_check_msa

# Add p5600-specific code tuning
MIPS32R5_OECONF += "${@'--with-abi=32 --with-arch=mips32r5 --with-tune=p5600' if '${DEFAULTTUNE}' in ['p5600', 'p5600el', 'p5600-nf', 'p5600el-nf'] else ''}"
MIPS32R5_OECONF += "${@'--with-float=hard --with-fp-32=xx' if '${DEFAULTTUNE}' in ['p5600', 'p5600el'] else ''}"
MIPS32R5_OECONF += "${@'--with-float=soft' if '${DEFAULTTUNE}' in ['p5600-nf', 'p5600el-nf'] else ''}"
```

## conf/machine/mitx.conf
```bitbake
#@TYPE: Machine
#@NAME: MITX MIPS
#@DESCRIPTION: Baikal-T1 based T-platforms MITX board

require conf/machine/include/baikal-t.inc

# Kernel and bootloader default configs
KBUILD_DEFCONFIG = "tplatforms_mitx_defconfig"
KERNEL_DEVICETREE = "baikal/tplatforms_mitx.dtb"
UBOOT_MACHINE = "tplatforms_mitx_defconfig"
```

## conf/machine/mrbt1.conf
```bitbake
#@TYPE: Machine
#@NAME: MRBT1 MIPS
#@DESCRIPTION: Baikal-T1 based T-platforms MRBT1 module

require conf/machine/include/baikal-t.inc

# Kernel and bootloader default configs
KBUILD_DEFCONFIG = "tplatforms_mrbt1_defconfig"
KERNEL_DEVICETREE = "baikal/tplatforms_mrbt1.dtb \
                     baikal/tplatforms_xa1-mrbt1.dtb"
UBOOT_MACHINE = "tplatforms_mrbt1_defconfig"
```

## conf/machine/msbt2.conf
```bitbake
#@TYPE: Machine
#@NAME: MSBT2 MIPS
#@DESCRIPTION: Baikal-T1 based T-platforms MSBT2 module

require conf/machine/include/baikal-t.inc

# Kernel and bootloader default configs
KBUILD_DEFCONFIG = "tplatforms_msbt2_defconfig"
KERNEL_DEVICETREE = "baikal/tplatforms_msbt2.dtb \
                     baikal/tplatforms_xa1-msbt2.dtb"
UBOOT_MACHINE = "tplatforms_msbt2_defconfig"
```
