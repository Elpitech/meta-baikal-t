## conf/machine/rt1mb.conf
```bitbake
#@TYPE: Machine
#@NAME: RT1MB MIPS
#@DESCRIPTION: Baikal-T1 based T-platforms RT1MB board

require conf/machine/include/baikal-t.inc

# Kernel and bootloader default configs
KBUILD_DEFCONFIG = "tplatforms_recovery_rt1mb_defconfig"
KERNEL_DEVICETREE = "baikal/tplatforms_rt1mb.dtb"
UBOOT_MACHINE = "tplatforms_rt1mb_defconfig"

PREFERRED_VERSION_linux-yocto = "4.9%"
KBRANCH ?= "linux-4.9-tp"

PREFERRED_VERSION_u-boot = "2019"
PREFERRED_VERSION_u-boot-mkimage = "2019"
PREFERRED_VERSION_u-boot-mkimage-native = "2019"
PREFERRED_VERSION_u-boot-mkimage-nativesdk = "2019"
PREFERRED_VERSION_u-boot-fw-utils = "2019"
```

## conf/machine/sbc101.conf
```bitbake
#@TYPE: Machine
#@NAME: SBC101 MIPS
#@DESCRIPTION: Baikal-T1 based T-platforms SBC101 board

require conf/machine/include/baikal-t.inc

# Kernel and bootloader default configs
KBUILD_DEFCONFIG = "tplatforms_sbc101_defconfig"
KERNEL_DEVICETREE = "baikal/tplatforms_sbc101.dtb"
UBOOT_MACHINE ?= "tplatforms_sbc101_defconfig"

PREFERRED_VERSION_linux-yocto = "4.9%"
KBRANCH ?= "linux-4.9-tp"

PREFERRED_VERSION_u-boot = "2019"
PREFERRED_VERSION_u-boot-mkimage = "2019"
PREFERRED_VERSION_u-boot-mkimage-native = "2019"
PREFERRED_VERSION_u-boot-mkimage-nativesdk = "2019"
PREFERRED_VERSION_u-boot-fw-utils = "2019"
```

## conf/machine/sfbt1.conf
```bitbake
#@TYPE: Machine
#@NAME: SFBT1 MIPS
#@DESCRIPTION: Baikal-T based T-platforms SFBT1 module

require conf/machine/include/baikal-t.inc

# Kernel and bootloader default configs
KBUILD_DEFCONFIG = "tplatforms_sfbt1_defconfig"
KERNEL_DEVICETREE = "baikal/tplatforms_sfbt1.dtb"
UBOOT_MACHINE = "tplatforms_sfbt1_defconfig"
```

## conf/machine/tc-msbt2.conf
```bitbake
#@TYPE: Machine
#@NAME: Tclient MSBT2 MIPS
#@DESCRIPTION: Baikal-T1 based T-platforms Tclient MSBT2 board

require conf/machine/include/baikal-t.inc

# Kernel and bootloader default configs
KBUILD_DEFCONFIG = "tplatforms_tc-msbt2_defconfig"
KERNEL_DEVICETREE = "baikal/tplatforms_tc-msbt2.dtb \
                     baikal/tplatforms_msbt2.dtb"
UBOOT_MACHINE = "tplatforms_tc-msbt2_defconfig"
```

## conf/machine/tc-sfbt1.conf
```bitbake
#@TYPE: Machine
#@NAME: Tclient SFBT1 MIPS
#@DESCRIPTION: Baikal-T based T-platforms Tclient SFBT1 board

require conf/machine/include/baikal-t.inc

# Kernel and bootloader default configs
KBUILD_DEFCONFIG = "tplatforms_tc-sfbt1_defconfig"
KERNEL_DEVICETREE = "baikal/tplatforms_tc-sfbt1.dtb"
UBOOT_MACHINE = "tplatforms_tc-sfbt1_defconfig"
```
